## conf/bblayers.conf.sample
```bitbake
# LAYER_CONF_VERSION is increased each time build/conf/bblayers.conf
# changes incompatibly
LCONF_VERSION = "6"

BBPATH = "${TOPDIR}"
BBFILES ?= ""

BBLAYERS ?= " \
  ##OEROOT##/meta \
  ##OEROOT##/meta-poky \
  ##OEROOT##/meta-yocto-bsp \
  ##OEROOT##/../meta-openembedded/meta-oe \
  ##OEROOT##/../meta-openembedded/meta-filesystems \
  ##OEROOT##/../meta-intel-srp \
  "
```

## conf/distro/intel-srp.conf
```bitbake
require conf/distro/poky.conf \
	${@bb.utils.contains('DISTRO_FEATURES', 'multilib', \
	'conf/multilib.conf', '', d)}

DISTRO = "intel-srp"
DISTRO_NAME = "Intel Soft Radio Project Distro"
DISTRO_VERSION = "${RELEASE_VERSION}"
DISTRO_CODENAME = "intel-srp"
SDK_VENDOR = "-srpsdk"
SDK_VERSION := "${RELEASE_VERSION}"

TARGET_VENDOR = "-intelsrp"
RELEASE_VERSION ?= "intelsrp"

include conf/distro/include/srp-custom.inc

BBMASK:append = " \
${@bb.utils.contains('DISTRO_FEATURES', 'simics', '', 'recipes-support/simics', d)} \
"
```

## conf/layer.conf
```bitbake
# We have a conf and classes directory, add to BBPATH
BBPATH .= ":${LAYERDIR}"

# We have recipes-* directories, add to BBFILES
BBFILES += "${LAYERDIR}/recipes-*/*/*.bb \
	${LAYERDIR}/recipes-*/*/*.bbappend"

BBFILE_COLLECTIONS += "intel-srp"
BBFILE_PATTERN_intel-srp := "^${LAYERDIR}/"
BBFILE_PRIORITY_intel-srp = "5"

LAYERSERIES_COMPAT_intel-srp = "kirkstone"
LAYERDEPENDS_intel-srp = " \
	core \
	yocto \
	openembedded-layer \
	filesystems-layer \
"
```

## conf/local.conf.sample
```bitbake
MACHINE = "srpeh"

# Release version should be the released tag for meta-intel-srp
# RELEASE_VERSION = ""

# Add simics support (sources should be in meta-intel-srp/download)
# and set simics version to compile (mandatory).
#DISTRO_FEATURES:append = " simics"
#SIMICS_VERSION = ""

# Enable "multilib"
#DISTRO_FEATURES:append = " multilib"

BB_NUMBER_THREADS ?= "${@oe.utils.cpu_count()}"
PARALLEL_MAKE ?= "-j ${@oe.utils.cpu_count()}"

# Assume directories were created under TOPDIR
#DL_DIR ?= "${TOPDIR}/downloads"
#SSTATE_DIR ?= "${TOPDIR}/sstate-cache"
#TMPDIR = "${TOPDIR}/tmp"

DISTRO = "intel-srp"
PACKAGE_CLASSES ?= "package_rpm"
EXTRA_IMAGE_FEATURES ?= "debug-tweaks"
USER_CLASSES ?= "buildstats"
PATCHRESOLVE = "noop"
BB_DISKMON_DIRS ??= "\
    STOPTASKS,${TMPDIR},1G,100K \
    STOPTASKS,${DL_DIR},1G,100K \
    STOPTASKS,${SSTATE_DIR},1G,100K \
    STOPTASKS,/tmp,100M,100K \
    HALT,${TMPDIR},100M,1K \
    HALT,${DL_DIR},100M,1K \
    HALT,${SSTATE_DIR},100M,1K \
    HALT,/tmp,10M,1K"
PACKAGECONFIG:append:pn-qemu-system-native = " sdl"
CONF_VERSION = "2"

# For more options check meta-intel-srp layer for README and 
# poky/meta-poky/conf/local.conf.sample.extended
```

## conf/machine/srpeh.conf
```bitbake
#@TYPE: Machine
#@NAME: srpeh
#@DESCRIPTION: Machine configuration for Intel HWC (Hawk Crest) Simulator within the Soft Radio Project (External Host)

DEFAULTTUNE ?= "core2-64"
DEFAULTTUNE:virtclass-multilib-lib32 ?= "core2-32"
MULTILIBS = "multilib:lib32"

require conf/machine/include/x86/tune-core2.inc
require conf/machine/include/genericx86-common.inc

PREFERRED_PROVIDER_virtual/kernel = "linux-yocto"
PREFERRED_VERSION_linux-yocto ?= "6.1%"
PREFERRED_VERSION_linux-yocto-debug ?= "6.1%"

KARCH = "x86_64"
KERNEL_IMAGETYPE = "bzImage"
KEEPUIMAGE = "no"

SERIAL_CONSOLES_CHECK = "ttyS0"

IMAGE_FSTYPES += "tar.gz"
```
